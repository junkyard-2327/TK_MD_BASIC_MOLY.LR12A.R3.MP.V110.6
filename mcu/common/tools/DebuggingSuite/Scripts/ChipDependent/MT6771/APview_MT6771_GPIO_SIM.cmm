// SIM GPIO
d.s &MEM_CLASS:0x10005340 %long %le data.long(&MEM_CLASS:0x10005340)&(0x00000FFF)
d.s &MEM_CLASS:0x10005340 %long %le data.long(&MEM_CLASS:0x10005340)|(0x11111000)

d.s &MEM_CLASS:0x10005350 %long %le data.long(&MEM_CLASS:0x10005350)&(0xFFFFFFF0)
d.s &MEM_CLASS:0x10005350 %long %le data.long(&MEM_CLASS:0x10005350)|(0x00000001)

d.s &MEM_CLASS:0x11E700C0 %long %le data.long(&MEM_CLASS:0x11E700C0)&(0XFF8FFFF8)
d.s &MEM_CLASS:0x11E700C0 %long %le data.long(&MEM_CLASS:0x11E700C0)|(0x00200002)
