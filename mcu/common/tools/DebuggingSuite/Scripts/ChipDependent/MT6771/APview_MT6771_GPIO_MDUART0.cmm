;Cannon MD_UART0 port test
;You should make sure GPIO84 has connected to UART port RXD pin,GPIO85 has connected to UART port TXD pin

;port: MDUART0
;Baudrate: 115200
;&BASE_ADDR_MDUART0=0xB0010000
sys.m prepare
&BASE_ADDR_MDUART0=0x20010000
&BASE_ADDR_MDGPIO=0x10005000
&BASE_ADDR_IOCFG=0x11E80000

D.S AXI:&BASE_ADDR_MDGPIO+0x310 %LE %LONG  0xCCC00000  //set GPIO13 to MD_URXD0 mode,set GPIO14 to MD_UTXD0 mode,
D.S AXI:&BASE_ADDR_IOCFG+0x60 %LE %LONG  data.long(AXI:&BASE_ADDR_IOCFG+0x60)&(0xFFFFFF7F)  //MD_UTXD0 pull disable
D.S AXI:&BASE_ADDR_IOCFG+0x60 %LE %LONG  data.long(AXI:&BASE_ADDR_IOCFG+0x60)|(0x00000040)  //MD_URXD0 pull enable
D.S AXI:&BASE_ADDR_IOCFG+0x80 %LE %LONG  data.long(AXI:&BASE_ADDR_IOCFG+0x80)|(0x00000040)  //MD_URXD0 pull up