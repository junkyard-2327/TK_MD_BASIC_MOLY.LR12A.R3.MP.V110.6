// Step 8: Set GPIO

&MEM_CLASS="AXI"
&BASE_ADDR_MDGPIO=0x10005000
;&BASE_ADDR_MDIOCFG=0x11C10000

// MD UART GPIO
D.S AXI:&BASE_ADDR_MDGPIO+0x318 %LE %LONG  0xFF00000  //Clear GPIO mode configure
D.S AXI:&BASE_ADDR_MDGPIO+0x314 %LE %LONG  0x4400000  //Set GPIO13/14 to UART mode.
D.S AXI:&BASE_ADDR_MDGPIO+0x64 %LE %LONG  0x01   //Set URXD Pull enable
D.S AXI:&BASE_ADDR_MDGPIO+0x84 %LE %LONG  0x01   //Set URXD Pull up select.

// SIM GPIO
d.s &MEM_CLASS:0x10005340 %long %le data.long(&MEM_CLASS:0x10005340)&(0x00000FFF)
d.s &MEM_CLASS:0x10005340 %long %le data.long(&MEM_CLASS:0x10005340)|(0x11111000)

d.s &MEM_CLASS:0x10005350 %long %le data.long(&MEM_CLASS:0x10005350)&(0xFFFFFFF0)
d.s &MEM_CLASS:0x10005350 %long %le data.long(&MEM_CLASS:0x10005350)|(0x00000001)

