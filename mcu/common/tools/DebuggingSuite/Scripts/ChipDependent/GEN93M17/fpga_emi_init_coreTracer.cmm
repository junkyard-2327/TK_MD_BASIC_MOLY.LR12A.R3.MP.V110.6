;sys.m prepare
;LOCAL &TYPE
LOCAL &BASE_MADDR_MDRGU
LOCAL &BASE_MADDR_APRGU
;IF DATA.LONG(DBG:0x41000000)==0x5BA02477     ; AP DAP
;(
;    &TYPE="EAHB"
;    &BASE_MADDR_MDRGU=0x800F0000
;)
;ELSE ; DATA.LONG(DBG:0x41000000)==0x6BA02477 ; MD DAP
;(
;    sys.m down
;    MULtiCore.DEBUGACCESSPORT 1
;    MULtiCore.AXIACCESSPORT 0
;    sys.m prepare
;    &TYPE="AXI"
;    &BASE_MADDR_MDRGU=0xA00F0000
;)

system.mode attach

D.S 0x1F000020 %LE %LONG 0x0000000F
D.S 0x1F000090 %LE %LONG 0xA0000000
D.S 0x1F000098 %LE %LONG 0xE0000002
D.S 0x1F0000A0 %LE %LONG 0xC0000000
D.S 0x1F0000A8 %LE %LONG 0xC0000002
; fixed md mips domain ID hw bug
D.S 0xA0060060 %LE %LONG 0x03231111


; do orginal disable_WDT2_MIPS.cmm
&BASE_MADDR_MDRGU=0xA00F0000
&BASE_MADDR_APRGU=0xC3670000

;D.S &BASE_MADDR_MDRGU+0x0100 %LE %LONG (0x55000000|data.long(&BASE_MADDR_MDRGU+0x0100)&~(0x3))
&temp=data.long(&BASE_MADDR_MDRGU+0x0100)
&temp=&temp | 0x55000000
&temp=&temp & ~(0x3)
D.S &BASE_MADDR_MDRGU+0x0100 %LE %LONG &temp


;D.S &BASE_MADDR_APRGU+0x0100 %LE %LONG (0x55000000|data.long(&BASE_MADDR_APRGU+0x0100)&~(0x1))
&temp=data.long(&BASE_MADDR_MDRGU+0x0100)
&temp=&temp | 0x55000000
&temp=&temp & ~(0x1)
D.S &BASE_MADDR_APRGU+0x0100 %LE %LONG &temp



; do orginal emi_init.cmm
LOCAL &CHIP_VER ; 0 is for FPGA, 1 is for E1, and so on
&CHIP_VER=0
&BASE_ADDR_EMI=0xC3000000
&BASE_ADDR_DRAMC=0xC3010000
&BASE_ADDR_DDRPHY=0xC3020000
&BASE_ADDR_MEMSYSAOREG_MISC=0xC3080000
&BASE_ADDR_AP_CLKSW=0xC3750000

; Check if initialize


&temp=DATA.LONG(&BASE_ADDR_EMI+0060)
&temp=&temp & 0x00000400
IF (&temp == 0x00000400)
(
    ENDDO
)

;DRAM initialization

GOSUB DRAM_INIT

PRINT "=============================="
PRINT "EMI Initialization Pass!"
PRINT "=============================="

D.S 0x0E800000 %LE %LONG 0x00
D.S 0x00080000 %LE %LONG 0x00

PRINT "=============================="
PRINT "Clear Dsp Header!"
PRINT "=============================="


;Enalbe cache to speed loading
register.set cdmmbase 0x1fc1407
D.S 0x1FC100D4 %LE %LONG 0x02030202
steal monitor adapter_khz 1100
steal monitor mips32 fastchannel 0 1 0x6f800000


PRINT "=============================="
PRINT "Start to Load elf !"
PRINT "=============================="


steal lo

steal monitor mips32 fastchannel 0 0 0x6f800000
D.S 0x1FC100D4 %LE %LONG 0x02020202

PRINT "=============================="
PRINT "Load elf Done!"
PRINT "=============================="

;thread.select 1

;&tt=var.address(INT_Initialize_Phase1)
;register.set pc &tt
;steal flushreg

;steal p/x $pc 
;&t=r(pc)
;PRINT "=============================="
;PRINT "Set PC to INT_Initialize_Phase1: &t"
;PRINT "=============================="

ENDDO


; =========================================================================================
; Sub Function: DRAM_INIT
; Description: initialize MEMPLL, DRAMC, DDRPHY, DRAM, EMI
; =========================================================================================
DRAM_INIT:
    ; =MEMSYS_PASSWORD=
    ; Unlock MEMSYS Password
    D.S &BASE_ADDR_MEMSYSAOREG_MISC+0x3000 %LE %LONG 0x24541689
    ;GOSUB MEMPLL_INIT
    GOSUB DRAMC_INIT
    GOSUB EMI_INIT
    ; =MEMINFRA_SI_WAY_CTL=
    ; Enable MEMINFRA EMI Path
    ; [9:8] M7_sysram:M7_emi
    ; [7:6] M6_sysram:M6_emi
    ; [5:4] M4_mdmda_sysram:M4_mddma_emi
    ; [3:2] M4_l1sys_sysram:M4_l1sys_emi
    ; [1:0] M3_sysram:M3_emi
    &reg_val=DATA.LONG(&BASE_ADDR_MEMSYSAOREG_MISC+0x4000)
    &reg_val=&reg_val|0x00000155
    D.S &BASE_ADDR_MEMSYSAOREG_MISC+0x4000 %LE %LONG &reg_val
    ; =EMI_ADDR_OFFSET=
    ; EMI offset on address[31:24], unit is 16MB
    &MD3_offset=0x00
    &MD2_offset=0x00
    &MD1_offset=0x10
    &ap_offset=0x00
    &emi_offset=(&MD3_offset<<0x18)+(&MD2_offset<<0x10)+(&MD1_offset<<0x08)+(&ap_offset<<0x00)
    D.S &BASE_ADDR_MEMSYSAOREG_MISC+0x1000 %LE %LONG &emi_offset
    ; =MEMSYS_PASSWORD=
    ; Lock MEMSYS Password
    D.S &BASE_ADDR_MEMSYSAOREG_MISC+0x3000 %LE %LONG 0x00000000
    RETURN

; =========================================================================================
; Sub Function: MEMPLL_INIT
; =========================================================================================
MEMPLL_INIT:
    DATA.LOAD.ELF &emi_elf_path
    B.D /ALL
    B.S custom_InitDRAM /HARD
    GO
    WAIT !RUN() 5.s
    IF r(PC)==custom_InitDRAM
    (
        PRINT "MEMPLL Initialization Pass!"
        RETURN
    )
    ELSE
    (
        PRINT "MEMPLL Initialization Failed!"
        ENDDO
    )

; =========================================================================================
; Sub Function: DRAMC_INIT
; Description: initialize DRAMC, DDRPHY, and DRAM, but this function doesn't initialize EMI
; =========================================================================================
DRAMC_INIT:
    ; =ACTIM0=
    D.S &BASE_ADDR_DRAMC+0x0000 %LE %LONG 0x44584493
    ; =CONF1=
    ; [18][5][3] no use in TK6291
    ; [9:8]MTYPE, DRAM column address width, 2'b01 (9-bit) -> 2'b10 (10-bit)
    ; TODO: [AC Timing] 0x00048683
    D.S &BASE_ADDR_DRAMC+0x0004 %LE %LONG 0xF0008681 ; 0xF0008481
    ; =R0DELDLY=
    D.S &BASE_ADDR_DRAMC+0x0018 %LE %LONG 0x10101010
    ; =R1DELDLY=
    ; [30:24][22:16][14:8][6:0] DQS3/2/1/0 input delay
    D.S &BASE_ADDR_DRAMC+0x001C %LE %LONG 0x12121212
    ; =DLLCONF=
    D.S &BASE_ADDR_DRAMC+0x0028 %LE %LONG 0x50000000
    ; =TEST2_3=
    ; [23] DQSICALI_NEW=0, using original dqs calibration
    ; [7] TESTAUDPAT=0, ISI pattern can be set by TEST2_PAT0
    D.S &BASE_ADDR_DRAMC+0x0044 %LE %LONG 0xBF080000
    ; =TEST2_4=
    D.S &BASE_ADDR_DRAMC+0x0048 %LE %LONG 0x1601110D
    ; =DDR2CTL=
    D.S &BASE_ADDR_DRAMC+0x007C %LE %LONG 0x00003201
    ; =MISC=
    ; [23:21]: PHYRXDSL_PIPE3~1 are pipe stage selection for RDATA and RDSEL
    ; DATLAT_DSEL = DATLAT - 2*2 when enabling two top pipe (for TK6291)
    D.S &BASE_ADDR_DRAMC+0x0080 %LE %LONG 0x00AC08A0
    ; =ZQCS=
    ; [15:8]: ZQCSAD, [7:0]: ZQCSOP
    &reg_val=DATA.LONG(&BASE_ADDR_DRAMC+0x0084) & ~0x0000FFFF
    &reg_val=&reg_val|0x00000A56
    D.S &BASE_ADDR_DRAMC+0x0084 %LE %LONG &reg_val
    ; =CLK1DELAY=
    ; [23]: PHYPIPE3EN, [22]: PHYPIPE2EN, [21]: PHYPIPE1EN
    &reg_val=DATA.LONG(&BASE_ADDR_DRAMC+0x008C) & ~0x00E00000
    &reg_val=&reg_val|0x00A00000
    D.S &BASE_ADDR_DRAMC+0x008C %LE %LONG &reg_val
    ; =R0DQSIEN=
    ; Gating Window for Rank0
    D.S &BASE_ADDR_DRAMC+0x0094 %LE %LONG 0x31313131
    ; =MCKDLY=
    ; [23]: WODT has no load (useless)
    ; [21]: DRAMEN has no load (useless)
    ; [11:10] DQIENQKEND: DQ/DQS input enable window is larger than 6582. [11:10]=2'b00 => dle counter is 5'1f. =Others => dle counter is DATLAT-[11:10]+2
    ; [4] DQIENLATEBEGIN, disable early begin, better for power saving
    ; TODO: [20]: It is used for BST(Bus Termination), but TK6291 doesn't support the feature
    D.S &BASE_ADDR_DRAMC+0x00D8 %LE %LONG 0x40500510
    ; =DQSCTL1=
    ; [27:24]: DQSINCTL, DQS input range control by M_CK
    ; [23:12][11:0]: DQS3CTL/DQS2CTL, control by DDRPHY (useless)
    D.S &BASE_ADDR_DRAMC+0x00E0 %LE %LONG 0x12200200
    ; =GDDR3CTL1=
    ; [24]: 8BKEN=1, 8-bank device enable
    &reg_val=DATA.LONG(&BASE_ADDR_DRAMC+0x00F4) | 0x01000000
    D.S &BASE_ADDR_DRAMC+0x00F4 %LE %LONG &reg_val
    ; [28]: PHYSYNCM=1, SYNC MODE using inverted PHY_M_CK
    &reg_val=DATA.LONG(&BASE_ADDR_DDRPHY+0x00F4) | 0x10000000
    D.S &BASE_ADDR_DDRPHY+0x00F4 %LE %LONG &reg_val
    ; =MISCTL0=
    ; [31]: REFP_ARB_EN2: per-bank refresh arbitration mask2
    ; [30:28]: TXP, tXP Timing setting
    ; [27] EMIPREEN: Enable advanced precharge function by EMI side-band signals, but TK6291 didn't support this feature.
    ; [26] REFP_ARB_EN: per-bank refresh blocks in EMI arbitration
    ; [25] REFA_ARB_EN: all-bank refresh blocks in EMI arbitration
    ; [24] PBC_ARB_EN:  block page-miss requests in EMI arbitration
    ; [21]: REFA_ARB_EN2: all bank refresh arbtration mask enable option
    D.S &BASE_ADDR_DRAMC+0x00FC %LE %LONG 0x81080000
    ; [17]: INTLBT=0, IO internal loop back (useless for TK6291)
    ; [16]: RXLPDDR2=0, IO voltage operating condition = {0:1.2V, 1:1.8V}
    &reg_val=DATA.LONG(&BASE_ADDR_DDRPHY+0x00FC) & ~0x00030000
    D.S &BASE_ADDR_DDRPHY+0x00FC %LE %LONG &reg_val
    ; =OCDK=
    ; [24]: DRVREF=1, drving change only when refresh cycle
    ; [15]: DRDELSWEN=1, enable DQS input delay switching for different ranks
    ; [8]: AUTOCALDRV=1, OCD calibration enable
    ; [7:0]: AUTOKCNT, auto calibration counter
    ; =RKCFG=
    ; [7]: per-bank refresh for LPDDR2&3
    ; TODO: [AC Timing] 0x004135C0
    D.S &BASE_ADDR_DRAMC+0x0110 %LE %LONG 0x004121C0
    ; =DQSCTL2=
    D.S &BASE_ADDR_DRAMC+0x0118 %LE %LONG 0x00000002
    ; =DQSGCTL=
    ; [7:0] Old gating window course tune
    &reg_val=DATA.LONG(&BASE_ADDR_DRAMC+0x0124) & ~0x000000FF
    D.S &BASE_ADDR_DRAMC+0x0124 %LE %LONG &reg_val
    ; [31]: NEWDQSG_SEL, [30]:DQSGDUALP
    &reg_val=DATA.LONG(&BASE_ADDR_DDRPHY+0x0124) | 0xC0000000
    D.S &BASE_ADDR_DDRPHY+0x0124 %LE %LONG &reg_val
    ; =CLKCTRL=
    ; [29]: CLK_EN_1, [28]: CLK_EN_0
    ; TODO: we should only enable one CLK for TK6291
    &reg_val=DATA.LONG(&BASE_ADDR_DRAMC+0x0130) | 0x30000000
    D.S &BASE_ADDR_DRAMC+0x0130 %LE %LONG &reg_val
    ; =ARBCTL0=
    ; [7:0]: maximum pending number to block the arbitration
    &reg_val=DATA.LONG(&BASE_ADDR_DRAMC+0x0168) & ~0x000000FF
    &reg_val=&reg_val|0x00000080
    D.S &BASE_ADDR_DRAMC+0x0168 %LE %LONG &reg_val
    ; =DQSCAL0=
    ; [31]: DQS strobe calibration enable
    ; [30]: Update tracking gating value to 2 ranks simultaneously
    ; [15]: Rank0 DQS strobe calibration high-limit enable
    ; [14:8]: Rank0 DQS strobe calibration high-limit value
    ; [7]: Rank0 DQS strobe calibration low-limit enable
    ; [6:0]: Rank0 DQS strobe calibration low-limit value
    &reg_val=DATA.LONG(&BASE_ADDR_DRAMC+0x01C0) & ~0xC000FFFF
    &reg_val=&reg_val | 0x80000000
    D.S &BASE_ADDR_DRAMC+0x01C0 %LE %LONG &reg_val
    ; =MEMSYSPIPE_CGF_CTL=
    ; [2]: PIPE_CFG_EN, [0]: DRAMC_CFG_EN
    ; PIPE_CGF_ON=0 (timing issue) EMI_CGF_ON=0(Gated function is already designed in EMI) DRAMC_CGF_ON=1
    D.S &BASE_ADDR_MEMSYSAOREG_MISC+0x5000 %LE %LONG 0x00000001
    ; =DRAMC_PD_CTRL=
    ; [24] REFFRERUN, using freerun clock to count refresh period
    ; [23:16] REFCNT_FR_CLK, refresh period based on DRAMC freerun clock cycles
    ; [15:8] TXREFCNT, tXSR
    IF (&CHIP_VER==0)
    (
        D.S &BASE_ADDR_DRAMC+0x01DC %LE %LONG 0xC2002340
    )
    ELSE
    (
        D.S &BASE_ADDR_DRAMC+0x01DC %LE %LONG 0xC3002340
    )
    ; =LPDDR2_3=
    ; TODO: should set to 0x10000000, not 0x3600_0000?
    ; [31]: DRAM address decode by DRAMC
    ; [28]: LPDDR2 enable
    ; [27]: enable register output data by DRAMC
    D.S &BASE_ADDR_DRAMC+0x01E0 %LE %LONG 0x36000000
    ; [30]: Select IO O1 as output
    ; [29&25:24&22:0]: DDR mode for pins
    ; [26]: fast IO output enable
    D.S &BASE_ADDR_DDRPHY+0x01E0 %LE %LONG 0x2601FFFF
    ; =ACTIM1=
    D.S &BASE_ADDR_DRAMC+0x01E8 %LE %LONG 0x81000510
    ; =PERFCTL0=
    ; [0] dual schedulers
    D.S &BASE_ADDR_DRAMC+0x01EC %LE %LONG 0x0010CF11
    ; TODO: AC_DERATING [0x01F0]
    ; =RRRATE_CTL=, =MRR_CTL=
    IF (&CHIP_VER==0) ; Or LPDDR3
    (
        D.S &BASE_ADDR_DRAMC+0x01F4 %LE %LONG 0x03020100
        D.S &BASE_ADDR_DRAMC+0x01Fc %LE %LONG 0x07060504
    )
    ELSE
    (
        D.S &BASE_ADDR_DRAMC+0x01F4 %LE %LONG 0x02030100
        D.S &BASE_ADDR_DRAMC+0x01Fc %LE %LONG 0x04060705
    )
    ; =AC_TIME_05T=
    D.S &BASE_ADDR_DRAMC+0x01F8 %LE %LONG 0x04002600
    ; =LPDDR2_4=
    ; clock 1x phase selection
    D.S &BASE_ADDR_DDRPHY+0x023C %LE %LONG 0x2201FFFF
    ; =SELPH1=
    ; TX 1x clock delay for CS1, RAS, CAS, WE, RESET, ODT, CKE, and CS
    D.S &BASE_ADDR_DRAMC+0x0400 %LE %LONG 0x00000000
    ; =SELPH2=
    ; TX 1x clock delay for CKE1, DQSGATE_P1, CMD, DQSGATE, BA[2:0]
    IF (&CHIP_VER==0)
    (
        D.S &BASE_ADDR_DRAMC+0x0404 %LE %LONG 0x00302000
    )
    ELSE
    (
        D.S &BASE_ADDR_DRAMC+0x0404 %LE %LONG 0x00101000
    )
    ; =SELPH3=
    ; TX 1x clock delay for RA[7:0]
    D.S &BASE_ADDR_DRAMC+0x0408 %LE %LONG 0x00000000
    ; =SELPH4=
    ; TX 1x clock delay for RA[15:8]
    D.S &BASE_ADDR_DRAMC+0x040C %LE %LONG 0x00000000
    ; =SELPH5=
    ; TX 0.5's 2x clock delay for CKE1, DQSGATE_P1, DQSGATE, BA[2:0], CS1, RAS, CAS, WE, RESET, ODT, CKE, CS
    IF (&CHIP_VER==0)
    (
        D.S &BASE_ADDR_DRAMC+0x0410 %LE %LONG 0x00955555
    )
    ELSE
    (
        D.S &BASE_ADDR_DRAMC+0x0410 %LE %LONG 0x57755555
    )
    ; TODO: SELPH6 [0x0414]
    ; =SELPH6_1=
    ; TX 1x clock delay for DQSGATE_P1 and DQSGATE of rank1
    ; TX 0.5's 2x clock delay for DQSGATE_P1 and DQSGATE of rank1
    D.S &BASE_ADDR_DRAMC+0x0418 %LE %LONG 0x00000228
    ; =SELPH7=
    ; TX 1x clock delay for DQ byte output enable[3:0] and DQ byte[3:0]
    D.S &BASE_ADDR_DRAMC+0x041C %LE %LONG 0x11111111
    ; =SELPH8=
    ; TX 1x clock delay for DQM byte output enable[3:0] and DQM byte[3:0]
    D.S &BASE_ADDR_DRAMC+0x0420 %LE %LONG 0x11111111
    ; =SELPH9=
    ; TX 1x clock delay for DQS byte output enable[3:0] and DQS byte[3:0]
    D.S &BASE_ADDR_DRAMC+0x0424 %LE %LONG 0x11111111
    ; =SELPH10=
    ; TX 0.5's 2x clock delay for DQM output enable[3:0], DQ byte output enable[3:0], DQM[3:0], and DQ byte[3:0]
    ; TODO: why we let output enable extra more 1.5 T not 0.5 DRAM clock?
    D.S &BASE_ADDR_DRAMC+0x0428 %LE %LONG 0x0000FFFF
    ; =SELPH11=
    ; TX 0.5's 2x clock delay for DQS output enable[3:0] and DQS[3:0]
    ; TODO: why we let output enable extra more 1.5 T not 0.5 DRAM clock?
    D.S &BASE_ADDR_DRAMC+0x042C %LE %LONG 0x000000FF
    ; TODO: offset 0x430~0x438, Don't we need to set clock 05x phase selection?
    ; =SELPH12=
    ; clock 05x phase selection for CLK, DQSGATE, DQS[3:0], and DQM[3:0]
    ; clock 1x phase selection for DQS[3:0], DQM[3:0], CLK, and DQSGATE
    D.S &BASE_ADDR_DDRPHY+0x0430 %LE %LONG 0x10F010F0
    ; =SELPH13=
    ; clock 1x phase selection for DQ[31:0]
    D.S &BASE_ADDR_DDRPHY+0x0434 %LE %LONG 0xFFFFFFFF
    ; =SELPH14=
    ; clock 05x phase selection for DQ[31:0]
    D.S &BASE_ADDR_DDRPHY+0x0438 %LE %LONG 0xFFFFFFFF
    ; =SELPH15=
    ; OCV (On-Chip Variation that affect by PVT). It is removed in TK6291.
    ; OCV mode for DQSGATE, DQS[3:0], DQ[31:0], CLK, and CA
    D.S &BASE_ADDR_DDRPHY+0x043C %LE %LONG 0x0000001F
    ; =MEMPLL_DIVIDER=
    ; DDRPHY reset flow for 1X clock phase sync
    ; [5]: MEMCLKENB, SW control. It is used for MEMPLL initialization. After initialization, CLKENB is controlled by HW mode.
    ; [4]: RG_DMSS_PWDB, ALLCLK_EN. It is used for gated MEMPLL output during initialization. (=1 after initilization)
    ; [0]: MEMCLKENB_SEL, memory clock sync enable bar selection, selection for [5] (=1 select[5])
    IF (&CHIP_VER!=0)
    (
        &reg_val=DATA.LONG(&BASE_ADDR_DDRPHY+0x0640) | 0x00000031
        D.S &BASE_ADDR_DDRPHY+0x0640 %LE %LONG &reg_val
    )
    ; TODO: wait 500 sys_clock equal to 1.87us?
    WAIT 2.us
    GOSUB LPDDR2_INIT
    IF (&CHIP_VER==0)
    (
        ; =CONF2=
        D.S &BASE_ADDR_DRAMC+0x0008 %LE %LONG 0x0000631F
        ; =DRAMC_PD_CTRL=
        ;&reg_val=DATA.LONG(&BASE_ADDR_DRAMC+0x01DC)&~0x00FF0000
        ;&reg_val=&reg_val|0x00350000
        ;D.S &BASE_ADDR_DRAMC+0x01DC %LE %LONG &reg_val
    )
    ELSE
    (
        ; =CONF2=
        ; [23]   FREBW_FREN, tREFBW use xtal clock counter enable
        ; [17:8] FREBW_FR, 6720ns/(XTALFR_clock)-1
        ; [7:0] REFCNT: AC Timing Calculation is 0x3F, but ESL use 0x3B
        ; TODO: [AC Timing] 0x0000003F
        D.S &BASE_ADDR_DRAMC+0x0008 %LE %LONG 0x03806D3B
        ; =DRAMC_PD_CTRL=
        ; [23:16] REFCNT_FR_CLK, refresh period based on DRAMC freerun clock cycles
        &reg_val=DATA.LONG(&BASE_ADDR_DRAMC+0x01DC) & ~0x00FF0000
        &reg_val=&reg_val | 0x00640000
        D.S &BASE_ADDR_DRAMC+0x01DC %LE %LONG &reg_val
    )
    RETURN

; =========================================================================================
; Sub Function: EMI_INIT
; =========================================================================================
EMI_INIT:
    ; =EMI_CONA=
    ; [27]: RANK_POS=0, {rank,row,bank,col}
    ; [17]: DUAL_RANK_EN=0
    ; [15:14][13:12]: ROW2ND=1,ROW=1, 14-bit row address
    ; [7:6][5:4]: COL2ND=1,COL=1, 10-bit column address
    ; [1]: DW32_EN=1, 32-bit data bus
    D.S &BASE_ADDR_EMI+0x0000 %LE %LONG 0x00005052
    ; =EMI_ARBI=
    D.S &BASE_ADDR_EMI+0x0140 %LE %LONG 0x20406188
    ; =EMI_ARBI_2ND=
    D.S &BASE_ADDR_EMI+0x0144 %LE %LONG 0x20406188
    ; =EMI_ARBD=
    D.S &BASE_ADDR_EMI+0x0118 %LE %LONG 0x0700704C
    ; =EMI_ARBE=
    D.S &BASE_ADDR_EMI+0x0120 %LE %LONG 0x40407068
    ; =EMI_ARBG=
    D.S &BASE_ADDR_EMI+0x0130 %LE %LONG 0xFFFF7045
    ; =EMI_ARBH=
    D.S &BASE_ADDR_EMI+0x0138 %LE %LONG 0xA0A07047
    ; TODO: CSR is not defined?
    D.S &BASE_ADDR_EMI+0x0040 %LE %LONG 0x80808807
    ; =EMI_ARBJ=
    ; TODO: it is not defined in CSRv0.9
    D.S &BASE_ADDR_EMI+0x0148 %LE %LONG 0x9719595E
    ; =EMI_ARBJ_2ND=
    ; TODO: it is not defined in CSRv0.9
    D.S &BASE_ADDR_EMI+0x014C %LE %LONG 0x9719595E
    ; =EMI_TEST_D=
    D.S &BASE_ADDR_EMI+0x00F8 %LE %LONG 0x00000000
    ; =EMI_BMEN=
    ; TODO: why do we need to enable BUS_MON_EN for DRAM Init?
    D.S &BASE_ADDR_EMI+0x0400 %LE %LONG 0x00FF0001
    ; =EMI_CONB=
    D.S &BASE_ADDR_EMI+0x0008 %LE %LONG 0x17283544
    ; =EMI_CONC=
    D.S &BASE_ADDR_EMI+0x0010 %LE %LONG 0x0A1A0B1A
    ; TODO: offset 0x18 is not defined in CSR.
    D.S &BASE_ADDR_EMI+0x0018 %LE %LONG 0x00000000
    ; =EMI_CONE=
    ; TODO: it is not defined in CSRv0.9
    D.S &BASE_ADDR_EMI+0x0020 %LE %LONG 0xFFFF0848
    ; =EMI_CONG=
    D.S &BASE_ADDR_EMI+0x0030 %LE %LONG 0x2B2B2A38
    ; =EMI_CONH=
    D.S &BASE_ADDR_EMI+0x0038 %LE %LONG 0x00000000
    ; =EMI_SLCT=
    ; TODO: Why do we enable [17]:M1_LLAT_EN?
    D.S &BASE_ADDR_EMI+0x0158 %LE %LONG 0xFF02FF00
    ; =EMI_MDCT=
    ; TODO: why don't we enable [14]:MDMCU_SBR_EN and [12]:ULTRA_SBR_EN?
    D.S &BASE_ADDR_EMI+0x0078 %LE %LONG 0x002F0C17
    ; TODO: it is not defined in CSR.
    D.S &BASE_ADDR_EMI+0x015C %LE %LONG 0x80030303
    ; =EMI_EMI_ARBK=
    ; TODO: it only defines [23:16] in CSRv0.9
    D.S &BASE_ADDR_EMI+0x0150 %LE %LONG 0x64F3FC79
    ; =EMI_ARBK_2ND=
    ; TODO: it is not defined in CSRv0.9
    D.S &BASE_ADDR_EMI+0x0154 %LE %LONG 0x64F3FC79
    ; =EMI_TESTC=
    ; TODO: it only enables [16:8] in CSRv0.9
    D.S &BASE_ADDR_EMI+0x00F0 %LE %LONG 0x38470000
    ; =EMI_TESTB=
    ; TODO: it didn't define [2:0] in CSRv0.9
    D.S &BASE_ADDR_EMI+0x00E8 %LE %LONG 0x00020027
    // Enable slave error
    D.S &BASE_ADDR_EMI+0x01C0 %LE %LONG 0x10000000
    D.S &BASE_ADDR_EMI+0x01C8 %LE %LONG 0x10000000
    D.S &BASE_ADDR_EMI+0x01D0 %LE %LONG 0x10000000
    D.S &BASE_ADDR_EMI+0x0200 %LE %LONG 0x10000000
    D.S &BASE_ADDR_EMI+0x02C0 %LE %LONG 0x10000000
    D.S &BASE_ADDR_EMI+0x02C8 %LE %LONG 0x10000000
    D.S &BASE_ADDR_EMI+0x02D0 %LE %LONG 0x10000000
    D.S &BASE_ADDR_EMI+0x0300 %LE %LONG 0x10000000
    ; =EMI_CONM=
    ; [10]: EMI_ENABLE=1
    D.S &BASE_ADDR_EMI+0x0060 %LE %LONG 0x000006B8
    ; =EMI_ARBP=
    ; EBM_MODE enable
    D.S &BASE_ADDR_EMI+0x0A20 %LE %LONG 0x00010000
    RETURN

; =========================================================================================
; Sub Function: LPDDR2_INIT
; =========================================================================================
LPDDR2_INIT:
    ; =PADCTL4=
    ; [2]: CKE always on, [0]: CKE control by controller
    ; CKE always on
    &reg_val=DATA.LONG(&BASE_ADDR_DRAMC+0x00E4) | 0x00000005
    D.S &BASE_ADDR_DRAMC+0x00E4 %LE %LONG &reg_val
    WAIT 200.us
    ; LPDDR2 MRW RESET
    GOSUB DRAMC_MRW 0x0000003F
    WAIT 10.us
    ; ZQ Init
    GOSUB DRAMC_MRW 0x00FF000A
    ; TODO: wait 1us after ZQ Initialization
    WAIT 1.us
    ; MRW MR1 => BL8, Sequential, Wrap, nWR=8
    GOSUB DRAMC_MRW 0x00C30001
    ; MRW MR2 => RL=8 and WL=4 for DDR1066
    GOSUB DRAMC_MRW 0x00060002
    ; MRW MR3 => 40-ohm typical
    GOSUB DRAMC_MRW 0x00020003
    ; =PADCTL4=
    ; [2]: CKE always on, [0]: CKE control by controller
    ; CKE is controlled by hardware
    &reg_val=DATA.LONG(&BASE_ADDR_DRAMC+0x00E4) & ~0x00000004
    D.S &BASE_ADDR_DRAMC+0x00E4 %LE %LONG &reg_val
    RETURN

; =========================================================================================
; Sub Function: DRAMC_MRW
; Description: DRAMC Mode Register Write
; argument:
;   @mrs mode register write value
; =========================================================================================
DRAMC_MRW:
    ENTRY &mrs
    LOCAL &spcmd
    &spcmd=0x00000001
    D.S &BASE_ADDR_DRAMC+0x0088 %LE %LONG &mrs
    D.S &BASE_ADDR_DRAMC+0x01E4 %LE %LONG &spcmd
    WAIT (DATA.LONG(&BASE_ADDR_DRAMC+0x03B8)&(&spcmd))==&spcmd
    D.S &BASE_ADDR_DRAMC+0x01E4 %LE %LONG 0x00000000
    WAIT (DATA.LONG(&BASE_ADDR_DRAMC+0x03B8)&(&spcmd))==0x00000000
    RETURN
