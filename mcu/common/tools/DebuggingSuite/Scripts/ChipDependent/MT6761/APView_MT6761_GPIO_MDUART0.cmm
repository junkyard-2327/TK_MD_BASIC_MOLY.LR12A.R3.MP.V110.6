;Merlot MD_UART0 port test
;You should make sure GPIO150 has connected to UART port RXD pin,GPIO151 has connected to UART port TXD pin

;port: MDUART0
;Baudrate: 115200
;&BASE_ADDR_MDUART0=0xB0010000
sys.m prepare
&BASE_ADDR_MDUART0=0x20010000
&BASE_ADDR_MDGPIO=0x10005000
&BASE_ADDR_IOCFG=0x10002600

D.S AXI:&BASE_ADDR_MDGPIO+0x420 %LE %LONG  data.long(AXI:&BASE_ADDR_MDGPIO+0x420)&(0x00FFFFFF) 
D.S AXI:&BASE_ADDR_MDGPIO+0x420 %LE %LONG  data.long(AXI:&BASE_ADDR_MDGPIO+0x420)|(0x55000000)  ;set GPIO150 to MD_URXD0 mode,set GPIO151 to MD_UTXD0 mode,

D.S AXI:&BASE_ADDR_IOCFG+0x60 %LE %LONG  data.long(AXI:&BASE_ADDR_IOCFG+0x60)&(0xFF7FFFFF)  ;MD_URXD0 pull dowm disable
D.S AXI:&BASE_ADDR_IOCFG+0x80 %LE %LONG  data.long(AXI:&BASE_ADDR_IOCFG+0x80)|(0x800000)  ;MD_URXD0 pull up enable
D.S AXI:&BASE_ADDR_IOCFG+0x80 %LE %LONG  data.long(AXI:&BASE_ADDR_IOCFG+0x80)&(0xFEFFFFFF)  ;MD_UTXD0 pull up disable