;sys.m prepare
;LOCAL &TYPE


system.mode attach

; configure GCR_ACCESS Register
; CoreTracer will access MO port via CPU to do following configuration
D.S 0x1F000020 %LE %LONG 0x0000000F
D.S 0x1F000090 %LE %LONG 0xA0000000
D.S 0x1F000098 %LE %LONG 0xE0000002
D.S 0x1F0000A0 %LE %LONG 0xC0000000
D.S 0x1F0000A8 %LE %LONG 0xC0000002



; do orginal APview_MT6765_disable_WDT.cmm
LOCAL &BASE_MADDR_MDRGU
&BASE_MADDR_MDRGU=0xA00F0000


PRINT "=============================="
PRINT "Disable MD WDT!"
PRINT "=============================="

;D.S &MEM_CLASS:&BASE_MADDR_MDRGU+0x100 %LE %LONG (0x55000030)
D.S &BASE_MADDR_MDRGU+0x0100 %LE %LONG 0x55000030



PRINT "=============================="
PRINT "config md_srclkena setting"
PRINT "=============================="

; /* Step 6 config md_srclkena setting */


; /* (1) INFRA_MISC2 */
&BASE_INFRACFG=(0xC0000000)
; /* (2) SRCLKEN_O1 force on */
&SPM_REG=(0xC0006000)



; /* (1) INFRA_MISC2 */
&INFRA_MISC2=(&BASE_INFRACFG+0x1F0C)
; /* (2) SRCLKEN_O1 force on */
&POWERON_CONFIG_EN=(&SPM_REG+0x0)
&SPM_POWER_ON_VAL1=(&SPM_REG+0x8)



; /* (1) INFRA_MISC2 */
; /* [3:0] : mdsrc_req_0_en = 4'b0001 */
;d.s (&MEM_CLASS:&INFRA_MISC2) %long %le data.long(&MEM_CLASS:&INFRA_MISC2)&(0xFFFFFFF0)
;d.s (&MEM_CLASS:&INFRA_MISC2) %long %le data.long(&MEM_CLASS:&INFRA_MISC2)|(0x1)

&temp=data.long(&INFRA_MISC2)
&temp=&temp &(0xFFFFFFF0)
D.S &INFRA_MISC2 %LE %LONG &temp

&temp=data.long(&INFRA_MISC2)
&temp=&temp |(0x1)
D.S &INFRA_MISC2 %LE %LONG &temp




; /* [7:4] : mdsrc_req_1_en = 4'b0010 */
;d.s (&MEM_CLASS:&INFRA_MISC2) %long %le data.long(&MEM_CLASS:&INFRA_MISC2)&(0xFFFFFF0F)
;d.s (&MEM_CLASS:&INFRA_MISC2) %long %le data.long(&MEM_CLASS:&INFRA_MISC2)|(0x20)


&temp=data.long(&INFRA_MISC2)
&temp=&temp &(0xFFFFFF0F)
D.S &INFRA_MISC2 %LE %LONG &temp

&temp=data.long(&INFRA_MISC2)
&temp=&temp |(0x20)
D.S &INFRA_MISC2 %LE %LONG &temp



; /* (2) SRCLKEN_O1 force on */
; //MMRF request
;D.S (&MEM_CLASS:&POWERON_CONFIG_EN) %LE %LONG  0x0B160001  //set SPM register for clkenal force on
;D.S (&MEM_CLASS:&SPM_POWER_ON_VAL1) %LE %LONG  0x00215830  //set src clkena1 force on
D.S &POWERON_CONFIG_EN %LE %LONG 0x0B160001
D.S &SPM_POWER_ON_VAL1 %LE %LONG 0x00215830

wait 1.ms



PRINT "=============================="
PRINT "config PLL setting"
PRINT "=============================="

; /* Step 5 config PLL setting */
&BASE_MADDR_APMIXEDSYS=(0xC000C000)
&BASE_MADDR_MDTOP_PLLMIXED=(0xA0140000)
&BASE_MADDR_MDTOP_CLKSW=(0xA0150000)

&REG_APMIXEDSYS_AP_PLL_CON0=(&BASE_MADDR_APMIXEDSYS+0x0)

&REG_MDTOP_PLLMIXED_DCXO_PLL_SETTLE_CTL=(&BASE_MADDR_MDTOP_PLLMIXED+0x4)
&REG_MDTOP_PLLMIXED_PLL_ON_CTL=(&BASE_MADDR_MDTOP_PLLMIXED+0x10)
&REG_MDTOP_PLLMIXED_MDMCUPLL_CTL0=(&BASE_MADDR_MDTOP_PLLMIXED+0x40)
&REG_MDTOP_PLLMIXED_MDVDSPPLL_CTL0=(&BASE_MADDR_MDTOP_PLLMIXED+0x48)
&REG_MDTOP_PLLMIXED_MDBRPPLL_CTL0=(&BASE_MADDR_MDTOP_PLLMIXED+0x50)
&REG_MDTOP_PLLMIXED_MDTXPLL_CTL0=(&BASE_MADDR_MDTOP_PLLMIXED+0x58)
&REG_MDTOP_PLLMIXED_MDBPIPLL_CTL0=(&BASE_MADDR_MDTOP_PLLMIXED+0x60)
&REG_MDTOP_PLLMIXED_MDBPIPLL_CTL1=(&BASE_MADDR_MDTOP_PLLMIXED+0x64)
&REG_MDTOP_PLLMIXED_MDPLL_CTL1=(&BASE_MADDR_MDTOP_PLLMIXED+0x104)
&REG_MDTOP_PLLMIXED_PLL_HP_RDY_IRQ=(&BASE_MADDR_MDTOP_PLLMIXED+0x314)
&REG_MDTOP_PLLMIXED_PLL_HP_RDY_IRQ_MASK=(&BASE_MADDR_MDTOP_PLLMIXED+0x318)
&REG_MDTOP_PLLMIXED_MDMCUPLL_STS=(&BASE_MADDR_MDTOP_PLLMIXED+0xC00)
&REG_MDTOP_PLLMIXED_PLL_DUMMY=(&BASE_MADDR_MDTOP_PLLMIXED+0xF00)

&REG_MDTOP_CLKSW_CLKON_CTL=(&BASE_MADDR_MDTOP_CLKSW+0x20)
&REG_MDTOP_CLKSW_CLKSEL_CTL=(&BASE_MADDR_MDTOP_CLKSW+0x24)
&REG_MDTOP_CLKSW_SDF_CK_CTL=(&BASE_MADDR_MDTOP_CLKSW+0x28)
&REG_MDTOP_CLKSW_MDSYS_BUS_FLEXCKGEN_STS=(&BASE_MADDR_MDTOP_CLKSW+0x84)

&MD_PLL_MAGIC_NUM=(0x62930000)

;;// initial CLKSQ_LPF
&temp=data.long(AXI:&REG_APMIXEDSYS_AP_PLL_CON0)
&temp=&temp|0x2
d.s &REG_APMIXEDSYS_AP_PLL_CON0 %long %le &temp
;;// 100us
wait 1.ms

;;// Default md_srclkena_ack settle time = 136T 32K
d.s &REG_MDTOP_PLLMIXED_DCXO_PLL_SETTLE_CTL %long %le 0x02020E88

;;// fixed 600MHz(/4), 343MHz(/7), 267MHz(/9) /* Fvco = 2400M */
d.s &REG_MDTOP_PLLMIXED_MDBPIPLL_CTL0 %long %le 0x801713B1
;;// 300MHz                                   /* Fvco = 2400M */
d.s &REG_MDTOP_PLLMIXED_MDTXPLL_CTL0 %long %le 0x80171400
;;// 400MHz                                   /* Fvco = 3600M */
d.s &REG_MDTOP_PLLMIXED_MDBRPPLL_CTL0 %long %le 0x80229E00
;;// 672MHz                                   /* Fvco = 3360M */
d.s &REG_MDTOP_PLLMIXED_MDVDSPPLL_CTL0 %long %le 0x80204E00
;;// 864MHz                                   /* Fvco = 3456M */
d.s &REG_MDTOP_PLLMIXED_MDMCUPLL_CTL0 %long %le 0x80213C00

;;// Polling until MDMCUPLL complete frequency adjustment
;WHILE ((data.long(&REG_MDTOP_PLLMIXED_MDMCUPLL_STS)>>14)&0x1)!=0
;(
;)
wait 1.ms

;;// Default disable BPI /7 clock
&temp=data.long(&REG_MDTOP_PLLMIXED_MDBPIPLL_CTL1)
&temp=&temp&(~0x80)
d.s &REG_MDTOP_PLLMIXED_MDBPIPLL_CTL1 %long %le &temp

;;/*TINFO="MDSYS_INIT: Update ABB MDPLL control register default value"*/
;;d.s &REG_MDTOP_PLLMIXED_MDPLL_CTL1 %long %le 0x4C43100

;;/* Force TXPLL ON due to TOPSM couldn't enable this PLL by default, TXPLL would be disable after DVFS Init. 
;;   other PLL ON controlled by HW" */
d.s &REG_MDTOP_PLLMIXED_PLL_ON_CTL %long %le 0x100010

;;    /*
;;    * Wait MD bus clock ready
;;    * Once MD bus ready, other clock should be ready too
;;    * In FPGA, the following status checking must be removed since there is no flex ck gen in FPGA.
;;    */
;WHILE (data.long(&REG_MDTOP_CLKSW_MDSYS_BUS_FLEXCKGEN_STS)&0x8000)!=0x8000
;(
)
wait 2.ms

;;// Switch MDMCU & MD BUS clock to PLL frequency
&temp=data.long(&REG_MDTOP_CLKSW_CLKSEL_CTL)
&temp=&temp|(0x3)
d.s &REG_MDTOP_CLKSW_CLKSEL_CTL %long %le &temp

;;// Switch all clock to PLL frequency
&temp=data.long(&REG_MDTOP_CLKSW_CLKSEL_CTL)
&temp=&temp|(0x58103FC)
d.s &REG_MDTOP_CLKSW_CLKSEL_CTL %long %le &temp

;;// Switch SDF clock to PLL frequency
&temp=data.long(&REG_MDTOP_CLKSW_SDF_CK_CTL)
&temp=&temp|(0x10)
d.s &REG_MDTOP_CLKSW_SDF_CK_CTL %long %le &temp
    
;;// Turn off all SW clock request, except ATB
d.s &REG_MDTOP_CLKSW_CLKON_CTL %long %le 0x1

;;// Clear PLL ADJ RDY IRQ fired by initial period adjustment
d.s &REG_MDTOP_PLLMIXED_PLL_HP_RDY_IRQ %long %le 0xFFFF

;;// Mask all PLL ADJ RDY IRQ
d.s &REG_MDTOP_PLLMIXED_PLL_HP_RDY_IRQ_MASK %long %le 0xFFFF

;;// Make a record that means MD pll has been initialized. 
;;/* Note: We use "MD_PLL_MAGIC_NUM|0x1" to know PLL init in MD C code. 
;;           If AP init PLL, it would be "MD_PLL_MAGIC_NUM". */
d.s &REG_MDTOP_PLLMIXED_PLL_DUMMY %long %le &MD_PLL_MAGIC_NUM


PRINT "=============================="
PRINT "Set GPIO!"
PRINT "=============================="
;;////// Step 8: Set GPIO
;;//// MD UART GPIO
&BASE_ADDR_MDGPIO=0xC0005000
&BASE_ADDR_IOCFG=0xC0002600
D.S &BASE_ADDR_MDGPIO+0x420 %LE %LONG  data.long(AXI:&BASE_ADDR_MDGPIO+0x420)&(0x00FFFFFF) 
D.S &BASE_ADDR_MDGPIO+0x420 %LE %LONG  data.long(AXI:&BASE_ADDR_MDGPIO+0x420)|(0x55000000)  ;//set GPIO150 to MD_URXD0 mode,set GPIO151 to MD_UTXD0 mode,
D.S &BASE_ADDR_IOCFG+0x60 %LE %LONG  data.long(AXI:&BASE_ADDR_IOCFG+0x60)&(0xFF7FFFFF)  ;//MD_URXD0 pull dowm disable
D.S &BASE_ADDR_IOCFG+0x80 %LE %LONG  data.long(AXI:&BASE_ADDR_IOCFG+0x80)|(0x800000)  ;//MD_URXD0 pull up enable
D.S &BASE_ADDR_IOCFG+0x80 %LE %LONG  data.long(AXI:&BASE_ADDR_IOCFG+0x80)&(0xFEFFFFFF)  ;//MD_UTXD0 pull up disable
;;//// SIM GPIO
;;// Clear bits
d.s 0xC0005348 %long %le 0x77777000
d.s 0xC0005358 %long %le 0x00000007
;;// Set bits
d.s 0xC0005344 %long %le 0x11111000
d.s 0xC0005354 %long %le 0x00000001

;;// SIM PUPD
;;// Control PAD_SIM1_SIO PUPD pin. PUPD=0: pull up, PUPD=1: pull down.
;;// Set bits
d.s 0xC0002454 %long %le 0x00000FC0
;;// Clear bits, SIO pull up
d.s 0xC0002458 %long %le 0x00000480

;;// SIM R1R0
;;// R1R0=00:High-Z, R1R0=01:PU 45kohm;PD 75kohm, 
;;// R1R0=10:PU 5kohm;PD 75kohm, R1R0=11:PU 45kohm/5kohm;PD 75kohm/75kohm.
;;// Set R1 bits
d.s 0xC0002484 %long %le 0x00000FC0

PRINT "=============================="
PRINT "Set MD EMI Remap!"
PRINT "=============================="


;Step 10 set MD EMI remap address (MD view: step 9)  ==>review done 
;d.s &MEM_CLASS:0xC0001300 %long %le 0x00430041
;d.s &MEM_CLASS:0xC0001304 %long %le 0x00470045
;d.s &MEM_CLASS:0xC0001308 %long %le 0x004b0049
;d.s &MEM_CLASS:0xC000130c %long %le 0x004f004d
D.S 0xC0001300 %LE %LONG 0x00430041
D.S 0xC0001304 %LE %LONG 0x00470045
D.S 0xC0001308 %LE %LONG 0x004b0049
D.S 0xC000130c %LE %LONG 0x004f004d

PRINT "=============================="
PRINT "Set MD EMI Remap!"
PRINT "=============================="


;Step 10 set MD EMI remap address (MD view: step 9)  ==>review done 
;d.s &MEM_CLASS:0xC0001300 %long %le 0x00430041
;d.s &MEM_CLASS:0xC0001304 %long %le 0x00470045
;d.s &MEM_CLASS:0xC0001308 %long %le 0x004b0049
;d.s &MEM_CLASS:0xC000130c %long %le 0x004f004d
D.S 0xC0001300 %LE %LONG 0x00430041
D.S 0xC0001304 %LE %LONG 0x00470045
D.S 0xC0001308 %LE %LONG 0x004b0049
D.S 0xC000130c %LE %LONG 0x004f004d


PRINT "=============================="
PRINT "Set AP2MD PATH Disable!"
PRINT "=============================="

; do AP to MD path disable
&BASE_ADDR_AP2MD_Dummy = 0xC0001370
&BASE_ADDR_INFRA_SET_CLEAR_PROT_EN=0xC00012A0


; Set reg_ap2md_dummy[0] = 1'b0
&temp=data.long(&BASE_ADDR_AP2MD_Dummy)
&temp = &temp & 0xFFFFFFFE
D.S &BASE_ADDR_AP2MD_Dummy %LE %LONG &temp
wait 1.ms

; Set peri2md_protect_en
; Write 0x1000_12A0[7] = 1'b1.
; MD can access AP if reg_ap2md_dummy[0] = 1'b1, 
&temp=data.long(&BASE_ADDR_INFRA_SET_CLEAR_PROT_EN)
&temp = &temp | 0x80
D.S &BASE_ADDR_INFRA_SET_CLEAR_PROT_EN %LE %LONG &temp
wait 1.ms

; Clear md2peri_protect_en
; Write 0x1000_12AC[6] = 1'b1.
&temp=data.long(&BASE_ADDR_INFRA_SET_CLEAR_PROT_EN+0xC)
&temp = &temp | 0x40
D.S &BASE_ADDR_INFRA_SET_CLEAR_PROT_EN+0xC %LE %LONG &temp
wait 1.ms

&temp=data.long(&BASE_ADDR_AP2MD_Dummy)
&temp = &temp | 0x1
D.S &BASE_ADDR_AP2MD_Dummy %LE %LONG &temp
wait 1.ms



;Enalbe cache to speed loading
;By setting bank 6 segment control attribute
register.set cdmmbase 0x1fc1407
D.S 0x1FC100D4 %LE %LONG 0x02030202
steal monitor adapter_khz 2000
steal monitor mips32 fastchannel 0 1 0x6f800000


PRINT "=============================="
PRINT "Start to Load elf !"
PRINT "=============================="

thread.select 1
steal lo

steal source ../cmm/coretracer\config\easyLoader\load_dsp.py

D.S 0x1FC100D4 %LE %LONG 0x02020202
PRINT "=============================="
PRINT "Load elf Done!"
PRINT "=============================="

thread.select 1

;&t=var.address(INT_Initialize_Phase1)
;wait 20.ms
;stop
;steal set $pc = &INT_Initialize_Phase1
;register.set pc &t

;PRINT "=============================="
;PRINT "Set PC to INT_Initialize_Phase1: &t"
;PRINT "=============================="

ENDDO

