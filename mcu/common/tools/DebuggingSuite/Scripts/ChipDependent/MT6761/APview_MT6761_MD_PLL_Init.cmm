; /* Step 6 config PLL setting */
;;==============================PLL init start==================================================
;;sys.m prepare
&MEM_CLASS="AXI"

&BASE_MADDR_APMIXEDSYS=(0x1000C000)
&BASE_MADDR_MDTOP_PLLMIXED=(0x20140000)
&BASE_MADDR_MDTOP_CLKSW=(0x20150000)

&REG_APMIXEDSYS_AP_PLL_CON0=(&BASE_MADDR_APMIXEDSYS+0x0)

&REG_MDTOP_PLLMIXED_DCXO_PLL_SETTLE_CTL=(&BASE_MADDR_MDTOP_PLLMIXED+0x4)
&REG_MDTOP_PLLMIXED_PLL_ON_CTL=(&BASE_MADDR_MDTOP_PLLMIXED+0x10)
&REG_MDTOP_PLLMIXED_MDMCUPLL_CTL0=(&BASE_MADDR_MDTOP_PLLMIXED+0x40)
&REG_MDTOP_PLLMIXED_MDVDSPPLL_CTL0=(&BASE_MADDR_MDTOP_PLLMIXED+0x48)
&REG_MDTOP_PLLMIXED_MDBRPPLL_CTL0=(&BASE_MADDR_MDTOP_PLLMIXED+0x50)
&REG_MDTOP_PLLMIXED_MDTXPLL_CTL0=(&BASE_MADDR_MDTOP_PLLMIXED+0x58)
&REG_MDTOP_PLLMIXED_MDBPIPLL_CTL0=(&BASE_MADDR_MDTOP_PLLMIXED+0x60)
&REG_MDTOP_PLLMIXED_MDBPIPLL_CTL1=(&BASE_MADDR_MDTOP_PLLMIXED+0x64)
&REG_MDTOP_PLLMIXED_MDPLL_CTL1=(&BASE_MADDR_MDTOP_PLLMIXED+0x104)
&REG_MDTOP_PLLMIXED_PLL_HP_RDY_IRQ=(&BASE_MADDR_MDTOP_PLLMIXED+0x314)
&REG_MDTOP_PLLMIXED_PLL_HP_RDY_IRQ_MASK=(&BASE_MADDR_MDTOP_PLLMIXED+0x318)
&REG_MDTOP_PLLMIXED_MDMCUPLL_STS=(&BASE_MADDR_MDTOP_PLLMIXED+0xC00)
&REG_MDTOP_PLLMIXED_PLL_DUMMY=(&BASE_MADDR_MDTOP_PLLMIXED+0xF00)


&REG_MDTOP_CLKSW_CLKON_CTL=(&BASE_MADDR_MDTOP_CLKSW+0x20)
&REG_MDTOP_CLKSW_CLKSEL_CTL=(&BASE_MADDR_MDTOP_CLKSW+0x24)
&REG_MDTOP_CLKSW_SDF_CK_CTL=(&BASE_MADDR_MDTOP_CLKSW+0x28)
&REG_MDTOP_CLKSW_MDSYS_BUS_FLEXCKGEN_STS=(&BASE_MADDR_MDTOP_CLKSW+0x84)

&MD_PLL_MAGIC_NUM=(0x62930000)

;;//Enables clock square1 low-pass filter for 26M quality.
d.s &MEM_CLASS:&REG_APMIXEDSYS_AP_PLL_CON0 %long %le data.long(&MEM_CLASS:&REG_APMIXEDSYS_AP_PLL_CON0)|0x2
;;// 100us
wait 1.ms

;;// Default md_srclkena_ack settle time = 136T 32K
d.s &MEM_CLASS:&REG_MDTOP_PLLMIXED_DCXO_PLL_SETTLE_CTL %long %le 0x02020E88

;;// fixed 600MHz(/4), 343MHz(/7), 267MHz(/9) /* Fvco = 2400M */
d.s &MEM_CLASS:&REG_MDTOP_PLLMIXED_MDBPIPLL_CTL0 %long %le 0x801713B1
;;// 300MHz                                   /* Fvco = 2400M */
d.s &MEM_CLASS:&REG_MDTOP_PLLMIXED_MDTXPLL_CTL0 %long %le 0x80171400
;;// 400MHz                                   /* Fvco = 3600M */
d.s &MEM_CLASS:&REG_MDTOP_PLLMIXED_MDBRPPLL_CTL0 %long %le 0x80229E00
;;// 672MHz                                   /* Fvco = 3360M */
d.s &MEM_CLASS:&REG_MDTOP_PLLMIXED_MDVDSPPLL_CTL0 %long %le 0x80204E00
;;// 864MHz                                   /* Fvco = 3456M */
d.s &MEM_CLASS:&REG_MDTOP_PLLMIXED_MDMCUPLL_CTL0 %long %le 0x80213C00

;;// Polling until MDMCUPLL complete frequency adjustment
;WHILE ((data.long(&MEM_CLASS:&REG_MDTOP_PLLMIXED_MDMCUPLL_STS)>>14)&0x1)!=0
;(
;)
wait 1.ms

;;// Default disable BPI /7 clock
d.s &MEM_CLASS:&REG_MDTOP_PLLMIXED_MDBPIPLL_CTL1 %long %le data.long(&MEM_CLASS:&REG_MDTOP_PLLMIXED_MDBPIPLL_CTL1)&0xFFFFFF7F

;;/*TINFO="MDSYS_INIT: Update ABB MDPLL control register default value"*/
;; d.s &MEM_CLASS:&REG_MDTOP_PLLMIXED_MDPLL_CTL1 %long %le 0x4C43100

;;/* Force TXPLL ON due to TOPSM couldn't enable this PLL by default, TXPLL would be disable after DVFS Init. 
;;   other PLL ON controlled by HW" */
d.s &MEM_CLASS:&REG_MDTOP_PLLMIXED_PLL_ON_CTL %long %le 0x100010

;;    /*
;;    * Wait MD bus clock ready
;;    * Once MD bus ready, other clock should be ready too
;;    * In FPGA, the following status checking must be removed since there is no flex ck gen in FPGA.
;;    */
;WHILE (data.long(&MEM_CLASS:&REG_MDTOP_CLKSW_MDSYS_BUS_FLEXCKGEN_STS)&0x8000)!=0x8000
;(
;)
wait 1.ms

;;// Switch MDMCU & MD BUS clock to PLL frequency
d.s &MEM_CLASS:&REG_MDTOP_CLKSW_CLKSEL_CTL %long %le data.long(&MEM_CLASS:&REG_MDTOP_CLKSW_CLKSEL_CTL)|(0x3)

;;// Switch all clock to PLL frequency
d.s &MEM_CLASS:&REG_MDTOP_CLKSW_CLKSEL_CTL %long %le data.long(&MEM_CLASS:&REG_MDTOP_CLKSW_CLKSEL_CTL)|(0x58103FC)

;;// Switch SDF clock to PLL frequency
d.s &MEM_CLASS:&REG_MDTOP_CLKSW_SDF_CK_CTL %long %le data.long(&MEM_CLASS:&REG_MDTOP_CLKSW_SDF_CK_CTL)|(0x10)

;;// Turn off all SW clock request, except ATB
d.s &MEM_CLASS:&REG_MDTOP_CLKSW_CLKON_CTL %long %le 0x1

;;// Clear PLL ADJ RDY IRQ fired by initial period adjustment
d.s &MEM_CLASS:&REG_MDTOP_PLLMIXED_PLL_HP_RDY_IRQ %long %le 0xFFFF

;;// Mask all PLL ADJ RDY IRQ
d.s &MEM_CLASS:&REG_MDTOP_PLLMIXED_PLL_HP_RDY_IRQ_MASK %long %le 0xFFFF

;;// Make a record that means MD pll has been initialized. 
;;/* Note: We use "MD_PLL_MAGIC_NUM|0x1" to know PLL init in MD C code. 
;;           If AP init PLL, it would be "MD_PLL_MAGIC_NUM". */
d.s &MEM_CLASS:&REG_MDTOP_PLLMIXED_PLL_DUMMY %long %le &MD_PLL_MAGIC_NUM
	
