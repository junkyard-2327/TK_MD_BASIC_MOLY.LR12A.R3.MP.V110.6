;;;;;;;;;;;;;;;;;;;;;;;;;;;;;;;;;;;;;;;;;;;;;;;;;;;;;;;;;;;;;;;;;;;;;;;;;;;;;;;
;; MT6765 PMIC golden setting dump
;;;;;;;;;;;;;;;;;;;;;;;;;;;;;;;;;;;;;;;;;;;;;;;;;;;;;;;;;;;;;;;;;;;;;;;;;;;;;;;

;; CLOCK & RESET
PRINT "=== CLOCK & RESET ==="
&MODULE_SW_CG_0_STA=0xC0001090
&MODULE_SW_CG_2_STA=0xC00010AC
&MODULE_SW_CG_3_STA=0xC00010C8
&ULPOSC_CLK_SEL=0xC0006684
&PMICW_CTRL=0xC05C4034
&PMICW_CLOCK_CTRL=0xC0001108
&CLK_CFG_7=0xC00000B0
&INFRA_GLOBALCON_RST2_STA=0xC0001148 

&tmp=DATA.LONG(&MODULE_SW_CG_0_STA)
PRINT "MODULE_SW_CG_0_STA         &MODULE_SW_CG_0_STA = &tmp"			
&tmp=DATA.LONG(&MODULE_SW_CG_2_STA)
PRINT "MODULE_SW_CG_2_STA         &MODULE_SW_CG_2_STA = &tmp"		
&tmp=DATA.LONG(&MODULE_SW_CG_3_STA)
PRINT "MODULE_SW_CG_3_STA         &MODULE_SW_CG_3_STA = &tmp"
&tmp=DATA.LONG(&ULPOSC_CLK_SEL)
PRINT "ULPOSC_CLK_SEL             &ULPOSC_CLK_SEL = &tmp"
&tmp=DATA.LONG(&PMICW_CTRL)
PRINT "PMICW_CTRL                 &PMICW_CTRL = &tmp"
&tmp=DATA.LONG(&PMICW_CLOCK_CTRL)
PRINT "PMICW_CLOCK_CTRL           &PMICW_CLOCK_CTRL = &tmp"
&tmp=DATA.LONG(&CLK_CFG_7)
PRINT "CLK_CFG_7                  &CLK_CFG_7 = &tmp"
&tmp=DATA.LONG(&INFRA_GLOBALCON_RST2_STA)
PRINT "INFRA_GLOBALCON_RST2_STA   &INFRA_GLOBALCON_RST2_STA = &tmp"

;; GPIO
PRINT "=== GPIO ==="
&GPIO_GPIO_MODE18=0xC0005420
&IOCFG_LM_DRV_CFG1=0xC0002210
&IOCFG_LM_PU_CFG0=0xC0002240
&IOCFG_LM_PD_CFG0=0xC0002230

&tmp=DATA.LONG(&GPIO_GPIO_MODE18)
PRINT "GPIO_GPIO_MODE18           &GPIO_GPIO_MODE18 = &tmp"			
&tmp=DATA.LONG(&IOCFG_LM_DRV_CFG1)
PRINT "IOCFG_LM_DRV_CFG1          &IOCFG_LM_DRV_CFG1 = &tmp"		
&tmp=DATA.LONG(&IOCFG_LM_PU_CFG0)
PRINT "IOCFG_LM_PU_CFG0           &IOCFG_LM_PU_CFG0 = &tmp"
&tmp=DATA.LONG(&IOCFG_LM_PD_CFG0)
PRINT "IOCFG_LM_PD_CFG0           &IOCFG_LM_PD_CFG0 = &tmp"

;; PMIC_WRAP
PRINT "=== PMIC_WRAP ==="
&MUX_SEL=0xC000D000
&WRAP_EN=0xC000D004 
&HPRIO_ARB_EN=0xC000D06C
&WACS0_EN=0xC000D08C
&INIT_DONE0=0xC000D090
&WACS0_RDATA=0xC000DC04

&tmp=DATA.LONG(&MUX_SEL)
PRINT "MUX_SEL                    &MUX_SEL = &tmp"			
&tmp=DATA.LONG(&WRAP_EN)
PRINT "WRAP_EN                    &WRAP_EN = &tmp"		
&tmp=DATA.LONG(&HPRIO_ARB_EN)
PRINT "HPRIO_ARB_EN               &HPRIO_ARB_EN = &tmp"
&tmp=DATA.LONG(&WACS0_EN)
PRINT "WACS0_EN                   &WACS0_EN = &tmp"
&tmp=DATA.LONG(&INIT_DONE0)
PRINT "INIT_DONE0                 &INIT_DONE0 = &tmp"
&tmp=DATA.LONG(&WACS0_RDATA)
PRINT "WACS0_RDATA                &WACS0_RDATA = &tmp"
