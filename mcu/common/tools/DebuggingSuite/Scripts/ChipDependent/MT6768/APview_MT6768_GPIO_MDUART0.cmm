;Talbot MD_UART0 port test
;You should make sure GPIO152 has connected to UART port RXD pin,GPIO153 has connected to UART port TXD pin

;port: MDUART0
;Baudrate: 1500000
;&BASE_ADDR_MDUART0=0xB0010000
sys.m prepare
&BASE_ADDR_MDUART0=0x20010000
&BASE_ADDR_MDGPIO=0x10005000
&BASE_ADDR_IOCFG=0x10002000

D.S AXI:&BASE_ADDR_MDGPIO+0x438 %LE %LONG  0x00000077; //clear GPIO152/153 to GPIO mode.
D.S AXI:&BASE_ADDR_MDGPIO+0x434 %LE %LONG  0x00000055; //set GPIO152 to RXD ,GPIO153 to TXD

D.S AXI:&BASE_ADDR_IOCFG+0x58 %LE %LONG  0x6000  ;//MD_URXD0/MD_UTXD0 PD clear
D.S AXI:&BASE_ADDR_IOCFG+0x64 %LE %LONG  0x2000  ;//MD_URXD0 PU set