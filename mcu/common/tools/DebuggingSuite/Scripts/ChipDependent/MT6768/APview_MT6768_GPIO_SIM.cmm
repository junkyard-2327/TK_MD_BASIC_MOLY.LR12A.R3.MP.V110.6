// SIM GPIO MODE
// Clear bits
d.s &MEM_CLASS:0x10005438 %long %le 0x00777000
d.s &MEM_CLASS:0x10005458 %long %le 0x07770000
// Set bits
d.s &MEM_CLASS:0x10005434 %long %le 0x00111000
d.s &MEM_CLASS:0x10005454 %long %le 0x01110000

// SIM PUPD
// Control PAD_SIM1_SIO PUPD pin. PUPD=0: pull up, PUPD=1: pull down.
// Set bits
d.s &MEM_CLASS:0x10002434 %long %le 0x00000FC0
// Clear bits, SIO pull up
d.s &MEM_CLASS:0x10002438 %long %le 0x00000480

// SIM R1R0
// R1R0=00:High-Z, R1R0=01:PU 45kohm;PD 75kohm, 
// R1R0=10:PU 5kohm;PD 75kohm, R1R0=11:PU 45kohm/5kohm;PD 75kohm/75kohm.
// Set R1 bits
d.s &MEM_CLASS:0x10002454 %long %le 0x00000FC0
