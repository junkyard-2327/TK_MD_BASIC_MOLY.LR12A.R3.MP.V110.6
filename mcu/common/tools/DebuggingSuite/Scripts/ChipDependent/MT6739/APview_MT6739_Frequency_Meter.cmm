;;;;;;;;;;;;;;;;;;;;;;;;;;;;;;;;;;;;;;;;;;;;;;;;;;;;;;;;;;;;;;;;;;;;;;;;;;;;;;;
;; ZION MD Frequency Meter
;;;;;;;;;;;;;;;;;;;;;;;;;;;;;;;;;;;;;;;;;;;;;;;;;;;;;;;;;;;;;;;;;;;;;;;;;;;;;;;

;;Select PLL
LOCAL &key_in
&key_in=0

LOCAL &opt_cvd_connect
&opt_cvd_connect="debug"

;;;;;;;;;;;;;;;;;;;;;;;Below you should change for each project;;;;;;;;;;;;;;;;;;;;;;;;;;;;;;;;;;;;
LOCAL &mclass           ;; Memory Class
&mclass="axi"
;&mclass="pm"

LOCAL &clksw_base         ;; MD CLKSW base address
;&clksw_base=0xA0150000    ;; MD view APB
;&clksw_base=0xA0096000    ;; MD view debug APB
&clksw_base=0x20150000    ;; AP view MD system bus
;&clksw_base=0x0D0D6000    ;; AP view MD debug sys

LOCAL &pll_base           ;; MD PLLMIXED base address
;&pll_base=0xA0140000      ;; MD view APB
;&pll_base=0xA0094000      ;; MD view debug APB
&pll_base=0x20140000      ;; AP view MD system bus
;&pll_base=0x0D0D4000      ;; AP view MD debug sys

&fqmtr_fcksel_32k_index=0x17
;;;;;;;;;;;;;;;;;;;;;;;Above you should change for each project;;;;;;;;;;;;;;;;;;;;;;;;;;;;;;;;;;;;

LOCAL &fqmtr_winset     ;; Frequency Meter Windoiw Setting (= Number of FIXED clock cycle)
&fqmtr_winset=0x1ff
&fqmtr_winset_for_32k=0x1E000     

LOCAL &fqmtr_fcksel_val ;; Frequency Meter FIXED clock selection
&fqmtr_fcksel_val=0x1a  ;; Select 26Mhz by default

;;;;;;;;;;;;;;;;;;;;;;;;;;;;;;;All the PLL you could select;;;;;;;;;;;;;;;;;;;;;;;;;;;;;;;;;;;;;;;;;;;;;;;;;
&SRC_STR_1="Reserved"
&SRC_STR_2="Reserved"
&SRC_STR_3="Reserved"
&SRC_STR_4="Reserved"
&SRC_STR_5="Reserved"
&SRC_STR_6="Reserved"
&SRC_STR_7="Reserved"
&SRC_STR_8="Reserved"
&SRC_STR_9="Reserved"
&SRC_STR_10="TRACE_MON_clock"
&SRC_STR_11="MDSYS_208M_clock"
&SRC_STR_12="mdrxsys_rake_clock"
&SRC_STR_13="mdrxsys_brp_clock"
&SRC_STR_14="mdrxsys_vdsp_clock"
&SRC_STR_15="mdtop_log_atb_clock"
&SRC_STR_16="fesys_csys_clock"
&SRC_STR_17="fesys_txsys_clock"
&SRC_STR_18="fesys_bsi_clock"
&SRC_STR_19="mdsys_mdcore_clock"
&SRC_STR_20="mdsys_bus2x_nodcm_clock"
&SRC_STR_21="mdsys_bus2x_clock"
&SRC_STR_22="mdtop_dbg_clock"
&SRC_STR_23="mdtop_f32k_clock"
&SRC_STR_24="MDBPIPLL_0_DIV2_clock"
&SRC_STR_25="MDBPIPLL_2_clock"
&SRC_STR_26="MDBPIPLL_1_clock"
&SRC_STR_27="MDBPIPLL_0_clock"
&SRC_STR_28="MDTXPLL_clock"
&SRC_STR_29="MDBRPPLL_clock"
&SRC_STR_30="MDVDSPPLL_clock"
&SRC_STR_31="MDMCUPLL_clock"

;;;;;;;;;;;;;;;;;;;;;;;;;;;;;;;;;;;;;;;;;;;;;;;;;;;;;;;;;;;;;;;;;;;;;;;;;;;;;;;;

DIALOG
(&
    HEADER "PLL Frequency Meter"
    ICON ":chip"
    
    POS  0. 0. 20. 1.
    LINE "FQMTR Selection"
    ;    x  y  w   h
    POS  0. 1. 20. 1.
    SEL.NONE:   CHOOSEBOX "None"
    (
        &key_in=0x00
    )
;;    SEL.1:      CHOOSEBOX "&SRC_STR_1"
;;    (
;;        &key_in=0x1
;;        &key_str="&SRC_STR_1"
;;    )
;;    SEL.2:      CHOOSEBOX "&SRC_STR_2"
;;    (
;;        &key_in=0x2
;;        &key_str="&SRC_STR_2"
;;    )
;;    SEL.3:      CHOOSEBOX "&SRC_STR_3"
;;    (
;;        &key_in=0x3
;;        &key_str="&SRC_STR_3"
;;   )
;;    SEL.4:      CHOOSEBOX "&SRC_STR_4"
;;    (
;;        &key_in=0x4
;;        &key_str="&SRC_STR_4"
;;    )
;;    SEL.5:      CHOOSEBOX "&SRC_STR_5"
;;    (
;;        &key_in=0x5
;;        &key_str="&SRC_STR_5"
;;    )
;;    SEL.6:      CHOOSEBOX "&SRC_STR_6"
;;    (
;;        &key_in=0x6
;;        &key_str="&SRC_STR_6"
;;    )
;;    SEL.7:      CHOOSEBOX "&SRC_STR_7"
;;    (
;;        &key_in=0x7
;;        &key_str="&SRC_STR_7"
;;    )
;;    SEL.8:      CHOOSEBOX "&SRC_STR_8"
;;    (
;;        &key_in=0x8
;;        &key_str="&SRC_STR_8"
;;    )
;;    SEL.9:      CHOOSEBOX "&SRC_STR_9"
;;    (
;;        &key_in=0x9
;;        &key_str="&SRC_STR_9"
;;    )
    SEL.10:     CHOOSEBOX "&SRC_STR_10"
    (
        &key_in=0xA
        &key_str="&SRC_STR_10"
    )
    SEL.11:     CHOOSEBOX "&SRC_STR_11"
    (
        &key_in=0xB
        &key_str="&SRC_STR_11"
    )
    SEL.12:     CHOOSEBOX "&SRC_STR_12"
    (
        &key_in=0xC
        &key_str="&SRC_STR_12"
    )
    SEL.13:     CHOOSEBOX "&SRC_STR_13"
    (
        &key_in=0xD
        &key_str="&SRC_STR_13"
    )
    SEL.14:     CHOOSEBOX "&SRC_STR_14"
    (
        &key_in=0xE
        &key_str="&SRC_STR_14"
    )
    SEL.15:     CHOOSEBOX "&SRC_STR_15"
    (
        &key_in=0xF
        &key_str="&SRC_STR_15"
    )
    SEL.16:     CHOOSEBOX "&SRC_STR_16"
    (
        &key_in=0x10
        &key_str="&SRC_STR_16"
    )
    SEL.17:     CHOOSEBOX "&SRC_STR_17"
    (
        &key_in=0x11
        &key_str="&SRC_STR_17"
    )
    SEL.18:     CHOOSEBOX "&SRC_STR_18"
    (
        &key_in=0x12
        &key_str="&SRC_STR_18"
    )
    SEL.19:     CHOOSEBOX "&SRC_STR_19"
    (
        &key_in=0x13
        &key_str="&SRC_STR_19"
    )
    SEL.20:     CHOOSEBOX "&SRC_STR_20"
    (
        &key_in=0x14
        &key_str="&SRC_STR_20"
    )
    SEL.21:     CHOOSEBOX "&SRC_STR_21"
    (
        &key_in=0x15
        &key_str="&SRC_STR_21"
    )
    SEL.22:     CHOOSEBOX "&SRC_STR_22"
    (
        &key_in=0x16
        &key_str="&SRC_STR_22"
    )
    SEL.23:     CHOOSEBOX "&SRC_STR_23"
    (
        &key_in=0x17
        &key_str="&SRC_STR_23"
    )
    SEL.24:     CHOOSEBOX "&SRC_STR_24"
    (
        &key_in=0x18
        &key_str="&SRC_STR_24"
    )
    SEL.25:     CHOOSEBOX "&SRC_STR_25"
    (
        &key_in=0x19
        &key_str="&SRC_STR_25"
    )
    SEL.26:     CHOOSEBOX "&SRC_STR_26"
    (
        &key_in=0x1A
        &key_str="&SRC_STR_26"
    )
    SEL.27:     CHOOSEBOX "&SRC_STR_27"
    (
        &key_in=0x1B
        &key_str="&SRC_STR_27"
   )
    SEL.28:     CHOOSEBOX "&SRC_STR_28"
    (
        &key_in=0x1C
        &key_str="&SRC_STR_28"
    )
    SEL.29:     CHOOSEBOX "&SRC_STR_29"
    (
        &key_in=0x1D
        &key_str="&SRC_STR_29"
    )
    SEL.30:     CHOOSEBOX "&SRC_STR_30"
    (
        &key_in=0x1E
        &key_str="&SRC_STR_30"
    )
    SEL.31:     CHOOSEBOX "&SRC_STR_31"
    (
        &key_in=0x1F
        &key_str="&SRC_STR_31"
    )

    POS  21. 0. 20. 1.
    LINE "FQMTR Information"
    INFO1: EDIT "Window Seting: &fqmtr_winset" ""
    INFO2: EDIT "Fixed Clock: &fqmtr_fcksel_val" ""
    INFO3: EDIT "32K measure support" ""	

    POSY 1. 20. 1.
    LINE "FQMTR Result"
    RESULT: EDIT "" ""

    POSY 1. 20. 1.
    DEFBUTTON "OK"
    (
        ;; Clear Result
        DIALOG.Set RESULT ""
        IF &key_in!=0
        (
            GOSUB fqmtr_query &key_in &key_str 1
        )
    )

    DEFBUTTON "LIST ALL"
    (
        ;; Clear Result
        DIALOG.Set RESULT ""
        GOSUB fqmtr_list_all
    )
    
    DEFBUTTON "Force LIST main clk"
    (
        ;; Clear Result
        DIALOG.Set RESULT ""
        GOSUB fqmtr_force_list_all
    )
  
    CLOSE 
    (
        PRINT "bye~"
        DIALOG.END
    )
)
    
    ;; Disable EDIT of showing information
    DIALOG.Disable INFO1
    DIALOG.Disable INFO2
    DIALOG.Disable INFO3	
    ;DIALOG.Disable RESULT
STOP
ENDDO

;;;;;The main function to get the Frequency. &idx==> the clock you select, &str==> clock name, &info==>list more info and wait 5ms in the function
;; &info=1 ==> for printing many PLLs at one time
fqmtr_query:
ENTRY &idx &str &info
(
    IF &info!=0
    (
        PRINT "&str: &idx"
        PRINT "fqmtrsrc: 0x" FORMAT.HEX(2,&idx)
        PRINT "opt_cvd_connect: &opt_cvd_connect"
    )

    LOCAL &unit
    LOCAL &fqmtr_winset_26M	
    LOCAL &fqmtr_result
    LOCAL &fqmtr_result_raw
    LOCAL &fqmtr_result_str
    LOCAL &safe_wait_cnt
    LOCAL &safe_wait_cnt_max
    LOCAL &mul_for_32k	

    &safe_wait_cnt=0

    IF &fqmtr_fcksel_val==0x1a ;; base on 26M, unit:MHz
    (
        IF &idx==&fqmtr_fcksel_32k_index ;; measure 32K 
        (		
            &unit="Khz"
            &fqmtr_winset_26M=&fqmtr_winset_for_32k
            &safe_wait_cnt_max=500 ;;5000 ms = 5s ==> in real test, longer than 5s, so reduce it
            &mul_for_32k=0x3E8
        )
        ELSE ;; measure PLL and other module
        (		
            &unit="Mhz"
            &fqmtr_winset_26M=&fqmtr_winset	
            &safe_wait_cnt_max=32 ;;32 ms
            &mul_for_32k=1			
        )		
    )
    ELSE
    (
        &unit=""
    )

    IF "&opt_cvd_connect"=="none"
    (
        sys.m prepare
    )
    ELSE IF "&opt_cvd_connect"=="debug"
    (
     ;   do nothing
    )
    ELSE IF "&opt_cvd_connect"=="ca7"
    (
        LOCAL &OPT_JTAG
        LOCAL &OPT_AP_NR_CPUS
        LOCAL &OPT_AP_COREBASE

        &OPT_JTAG=0
        &OPT_AP_NR_CPUS=2
        &OPT_AP_COREBASE="0x80070000 0x80072000"
        ;&OPT_AP_NR_CPUS=4
        ;&OPT_AP_COREBASE="0x80070000 0x80072000 0x80074000 0x80076000"
        DO CA7_connect.cmm
    )
    ELSE
    (
        IF &info!=0
        (
            PRINT "No explicit CVD connection, use current status"
        )
    )

    IF &idx==0
    (
        ;; This is used for connect CVD only, no FQMTR test
        RETURN
    )

	;;div 8 and select src
	Data.Set &mclass:(&clksw_base+0x0104) %LE %LONG 0x0 ;reset frequency meter
	Data.Set &mclass:(&clksw_base+0x0100) %LE %LONG (0x0300)|(&idx)
	Data.Set &mclass:(&clksw_base+0x0108) %LE %LONG &fqmtr_winset_26M
	Data.Set &mclass:(&clksw_base+0x0104) %LE %LONG 0x1 ;enable frequency meter


    ;; read status, to check polling done or not
    &fqmtr_busy=DATA.LONG(&mclass:(&clksw_base+0x0104))&(1<<1)
    WHILE &fqmtr_busy==0
    (
        ;PRINT ". &fqmtr_busy"
        &fqmtr_busy=DATA.LONG(&mclass:(&clksw_base+0x0104))&(1<<1)
        &safe_wait_cnt=&safe_wait_cnt+1
        IF &safe_wait_cnt==&safe_wait_cnt_max
        (
            PRINT "[&str] Wait Fail, exit"
            DIALOG.Set RESULT "Wait Fail(No clock), exit"			
            RETURN
        )
        ELSE 
        (		
;;            PRINT "Waiting result. safe_wait_cnt=" "&safe_wait_cnt"			
        )		
        WAIT 1ms
    )
	
    ;; Calculate the result
    &fqmtr_result_raw=DATA.LONG(&mclass:(&clksw_base+0x10c))
    &fqmtr_result=&fqmtr_result_raw*&fqmtr_fcksel_val*8*&mul_for_32k/&fqmtr_winset_26M
    &fqmtr_result_dec=FORMAT.DECIMAL(0,&fqmtr_result)
    &fqmtr_result_str=""+FORMAT.DECIMAL(0,&fqmtr_result)+" &unit"
    IF &info==0
    (
        PRINT "0x" FORMAT.HEX(2,&idx) ",&fqmtr_result_dec,&unit,&str,&fqmtr_result_raw,"
    )
    ELSE
    (
        PRINT "Frequency Meter Result: &fqmtr_result_str (&fqmtr_result_raw)"
        PRINT ""
    )
    DIALOG.Set RESULT "&fqmtr_result_str"

    IF &info==0
    (
        WAIT 5ms
    )

    RETURN
)
;;;;;;;;;;;;;;;;;;;;;;;;;;;;;;;;;;;;;;;;;;;;;;;;;;;;;;;;;;;;;;;;;;;;;;;;;;;;;;;;
fqmtr_create_win:
(
	AREA.RESet
	AREA.Create PLL_FMETER
	AREA.Select PLL_FMETER
	WinPOS 10.,0.,50.,35.,,, FMETER
	AREA.view PLL_FMETER
	AREA.Clear PLL_FMETER
	RETURN
)

fqmtr_list_all:
(
    GOSUB fqmtr_create_win

    ;GOSUB fqmtr_query  0x1 &SRC_STR_1  0
    ;GOSUB fqmtr_query  0x2 &SRC_STR_2  0
    ;GOSUB fqmtr_query  0x3 &SRC_STR_3  0
    ;GOSUB fqmtr_query  0x4 &SRC_STR_4  0
    ;GOSUB fqmtr_query  0x5 &SRC_STR_5  0
    ;GOSUB fqmtr_query  0x6 &SRC_STR_6  0
    ;GOSUB fqmtr_query  0x7 &SRC_STR_7  0
    ;GOSUB fqmtr_query  0x8 &SRC_STR_8  0
    ;GOSUB fqmtr_query  0x9 &SRC_STR_9  0
    GOSUB fqmtr_query  0xA &SRC_STR_10 0
    GOSUB fqmtr_query  0xB &SRC_STR_11 0
    GOSUB fqmtr_query  0xC &SRC_STR_12 0
    GOSUB fqmtr_query  0xD &SRC_STR_13 0
    GOSUB fqmtr_query  0xE &SRC_STR_14 0
    GOSUB fqmtr_query  0xF &SRC_STR_15 0
    GOSUB fqmtr_query 0x10 &SRC_STR_16 0
    GOSUB fqmtr_query 0x11 &SRC_STR_17 0
    GOSUB fqmtr_query 0x12 &SRC_STR_18 0
    GOSUB fqmtr_query 0x13 &SRC_STR_19 0
    GOSUB fqmtr_query 0x14 &SRC_STR_20 0
    GOSUB fqmtr_query 0x15 &SRC_STR_21 0
    GOSUB fqmtr_query 0x16 &SRC_STR_22 0
    GOSUB fqmtr_query 0x17 &SRC_STR_23 0
    GOSUB fqmtr_query 0x18 &SRC_STR_24 0
    GOSUB fqmtr_query 0x19 &SRC_STR_25 0
    GOSUB fqmtr_query 0x1A &SRC_STR_26 0
    GOSUB fqmtr_query 0x1B &SRC_STR_27 0
    GOSUB fqmtr_query 0x1C &SRC_STR_28 0
    GOSUB fqmtr_query 0x1D &SRC_STR_29 0
    GOSUB fqmtr_query 0x1E &SRC_STR_30 0
    GOSUB fqmtr_query 0x1F &SRC_STR_31 0
    RETURN
)

fqmtr_force_list_all:
(
    GOSUB fqmtr_create_win

    LOCAL &original_reg
    LOCAL &original_BPIPLLCTL1_reg	
	
    &original_reg=DATA.LONG(&mclass:(&pll_base+0x10))
    &original_BPIPLLCTL1_reg=DATA.LONG(&mclass:(&pll_base+0x64))
	
    ; S/W force on all PLL
    Data.Set &mclass:(&pll_base+0x10) %LE %LONG 0xFFFFFFFF
	
    ; S/W force on BPI_1 PLL	
    Data.Set &mclass:(&pll_base+0x64) %LE %LONG &original_BPIPLLCTL1_reg|(0x80)	
	
    WAIT 1.s

    ;GOSUB fqmtr_query  0x1 &SRC_STR_1  0
    ;GOSUB fqmtr_query  0x2 &SRC_STR_2  0
    ;GOSUB fqmtr_query  0x3 &SRC_STR_3  0
    ;GOSUB fqmtr_query  0x4 &SRC_STR_4  0
    ;GOSUB fqmtr_query  0x5 &SRC_STR_5  0
    ;GOSUB fqmtr_query  0x6 &SRC_STR_6  0
    ;GOSUB fqmtr_query  0x7 &SRC_STR_7  0
    ;GOSUB fqmtr_query  0x8 &SRC_STR_8  0
    ;GOSUB fqmtr_query  0x9 &SRC_STR_9  0
    GOSUB fqmtr_query  0xA &SRC_STR_10 0
    GOSUB fqmtr_query  0xB &SRC_STR_11 0
    GOSUB fqmtr_query  0xC &SRC_STR_12 0
    GOSUB fqmtr_query  0xD &SRC_STR_13 0
    GOSUB fqmtr_query  0xE &SRC_STR_14 0
    GOSUB fqmtr_query  0xF &SRC_STR_15 0
    GOSUB fqmtr_query 0x10 &SRC_STR_16 0
    GOSUB fqmtr_query 0x11 &SRC_STR_17 0
    GOSUB fqmtr_query 0x12 &SRC_STR_18 0
    GOSUB fqmtr_query 0x13 &SRC_STR_19 0
    GOSUB fqmtr_query 0x14 &SRC_STR_20 0
    GOSUB fqmtr_query 0x15 &SRC_STR_21 0
    GOSUB fqmtr_query 0x16 &SRC_STR_22 0
    GOSUB fqmtr_query 0x17 &SRC_STR_23 0
    GOSUB fqmtr_query 0x18 &SRC_STR_24 0
    GOSUB fqmtr_query 0x19 &SRC_STR_25 0
    GOSUB fqmtr_query 0x1A &SRC_STR_26 0
    GOSUB fqmtr_query 0x1B &SRC_STR_27 0
    GOSUB fqmtr_query 0x1C &SRC_STR_28 0
    GOSUB fqmtr_query 0x1D &SRC_STR_29 0
    GOSUB fqmtr_query 0x1E &SRC_STR_30 0
    GOSUB fqmtr_query 0x1F &SRC_STR_31 0

    ; Revert to original value
    Data.Set &mclass:(&pll_base+0x10) %LE %LONG &original_reg
    Data.Set &mclass:(&pll_base+0x64) %LE %LONG &original_BPIPLLCTL1_reg	
	
    WAIT 1.s

    RETURN
)
