&BASE_ADDR_MDGPIO=0x10005000
;&BASE_ADDR_MDGPIO=0xC0005000

D.S AXI:&BASE_ADDR_MDGPIO+0x338 %LE %LONG  0x00FF000  //Clear GPIO mode configure
D.S AXI:&BASE_ADDR_MDGPIO+0x334 %LE %LONG  0x0066000  //Set GPIO27/28 to UART mode.
D.S AXI:&BASE_ADDR_MDGPIO+0x64 %LE %LONG  0x02000   //Set URXD Pull up enable
D.S AXI:&BASE_ADDR_MDGPIO+0x48 %LE %LONG  0x02000   //Set URXD Pull down disable.
