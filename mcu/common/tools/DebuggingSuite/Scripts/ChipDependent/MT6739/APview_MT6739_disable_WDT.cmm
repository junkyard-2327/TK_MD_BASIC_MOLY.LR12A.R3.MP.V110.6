;/* Step 6 Disable MD/AP WDT */
&MEM_CLASS="AXI"

;&BASE_MADDR_MDRGU=0xA00F0000
;&BASE_MADDR_APRGU=0xC0007000
&BASE_MADDR_MDRGU=0x200F0000
;&BASE_MADDR_APRGU=0x10007000

D.S &MEM_CLASS:&BASE_MADDR_MDRGU+0x0100 %LE %LONG (0x55000030)
;D.S &MEM_CLASS:&BASE_MADDR_APRGU %LE %LONG 0x22000064

