&MEM_CLASS="AXI"
; do AP to MD path disable
LOCAL &BASE_ADDR_AP2MD_Dummy 
LOCAL &BASE_ADDR_INFRA_PERI2MD_PROT_EN 
LOCAL &BASE_ADDR_INFRA_MD2PERI_PROT_EN 
LOCAL &temp 

&BASE_ADDR_AP2MD_Dummy=0x10001370
&BASE_ADDR_INFRA_PERI2MD_PROT_EN=0x10001220
&BASE_ADDR_INFRA_MD2PERI_PROT_EN=0x10001250


&temp=data.long(&MEM_CLASS:(&BASE_ADDR_INFRA_PERI2MD_PROT_EN+0x0))|0x80
;PRINT "temp=" "&temp"
;PRINT "BASE_ADDR_INFRA_PERI2MD_PROT_EN=" "&BASE_ADDR_INFRA_PERI2MD_PROT_EN"
D.S &MEM_CLASS:(&BASE_ADDR_INFRA_PERI2MD_PROT_EN+0x0) %LE %LONG &temp

&temp=data.long(&MEM_CLASS:(&BASE_ADDR_INFRA_MD2PERI_PROT_EN+0x0))&0xFFFFFFBF
;PRINT "temp=" "&temp"
;PRINT "BASE_ADDR_INFRA_MD2PERI_PROT_EN=" "&BASE_ADDR_INFRA_MD2PERI_PROT_EN"
D.S &MEM_CLASS:(&BASE_ADDR_INFRA_MD2PERI_PROT_EN+0x0) %LE %LONG &temp
wait 1.ms

&temp=data.long(&MEM_CLASS:(&BASE_ADDR_AP2MD_Dummy+0x0))|0x1
;PRINT "temp=" "&temp"
;PRINT "BASE_ADDR_AP2MD_Dummy=" "&BASE_ADDR_AP2MD_Dummy"
D.S &MEM_CLASS:(&BASE_ADDR_AP2MD_Dummy+0x0) %LE %LONG &temp  
wait 1.ms

